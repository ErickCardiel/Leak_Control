#include <ESP8266WiFi.h>
#include <PubSubClient.h> // in order to work this program change MQTT_MAX_PACKET_SIZE from this header
#include <time.h>

const unsigned char private_der[] = {
0x30, 0x82, 0x04, 0xA2, 0x02, 0x01, 0x00, 0x02, 0x82, 0x01, 0x01, 0x00, 0xC7, 0x57, 0x3C, 0xF4, 
0xB3, 0xAF, 0x6D, 0x00, 0xFD, 0x51, 0x93, 0x36, 0x84, 0xB5, 0x5C, 0x11, 0xFA, 0x1A, 0x54, 0x81, 
0xAC, 0xBA, 0x14, 0xF7, 0x64, 0x90, 0x61, 0xC4, 0x93, 0xD4, 0xF6, 0xE4, 0x35, 0x53, 0x21, 0xFB, 
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0x04, 0x76, 0xBC, 0x93, 0x67, 0x9A
};

const unsigned int private_der_len = 1191;

const unsigned char cert_der[] = {
0x30, 0x82, 0x03, 0x59, 0x30, 0x82, 0x02, 0x41, 0xA0, 0x03, 0x02, 0x01, 0x02, 0x02, 0x14, 0x57, 
0xE8, 0xD7, 0x24, 0x15, 0x71, 0x0D, 0x35, 0x99, 0x60, 0x6F, 0x32, 0x0E, 0xCA, 0x86, 0x83, 0xE1, 
0x25, 0x61, 0xA3, 0x30, 0x0D, 0x06, 0x09, 0x2A, 0x86, 0x48, 0x86, 0xF7, 0x0D, 0x01, 0x01, 0x0B, 
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0x6F, 0xD2, 0x1A, 0xAA, 0x2C, 0x27, 0xC7, 0x43, 0x51, 0x90, 0x73, 0x43, 0x1D
};

const unsigned int cert_der_len = 862;

const char* ssid = "GLS";               //Izzinet4872       STR              ErickPhone       Alberto-WiFi
const char* password = "icicicic";      //50217248          LABRTS2011-1     gbw1rghxroxyy    alberto1269
const char* mqtt_server = "xxxxxxxxxxxxxx-xxx.iot.xx-xxxx-x.amazonaws.com";   // aws host
const char* endPointPost = "$aws/things/xxxx/shadow/update";    // xxxx = your "Thing" name     
const char* suscribeTopic = "$aws/things/xxxx/pipeState";       // xxxx = your "Thing" name

WiFiClientSecure wifiClient;
PubSubClient mqttClient(wifiClient);

unsigned char data[1000];
char shadowAPI[200];
const int acceptanceRange = 0;

char dataFromSerial[10];
char jsonArray[300];

unsigned long time1 = 0;
unsigned long time2 = 0;
unsigned int cntLastPulses = 0;
char possibleLeak = '0';    
char hourArrayChar[2], minArrayChar[2];

int gpio_PWMA;
int gpio_AIN2;
int gpio_AIN1;
int gpio_STBY;

int longArray = 0;
int timezone = 7 * 3600;
int dst = 0;

void setup_wifiClient() 
{
  wifiClient.setCertificate(cert_der, cert_der_len);
  wifiClient.setPrivateKey(private_der, private_der_len);
}

void callback(char* topic, byte* payload, unsigned int length) 
{
  Serial.print("Topic [");
  Serial.print(topic);
  Serial.println("]");

  String payloadString = String((char *)payload);
  
  Serial.print("Payload [");
  Serial.print(payloadString);
  Serial.println("]");

  if(payloadString.indexOf("\"closePipe\" : 1") >= 0)
  {
    Serial.println("Closing valve...");
    mqttClient.unsubscribe(suscribeTopic);
    mqttClient.publish(suscribeTopic,"{\"state\":{\"reported\":{\"closePipe\" : 0}}}");
    mqttClient.subscribe(suscribeTopic);
    valve_close();
  }
  else
  {
    Serial.print("\nOpen valve...");
    valve_open();
  } 
}

void reconnect() {
  while (!mqttClient.connected()) 
  {
    Serial.print("Attempting MQTT connection...");
    String clientId = "ESP8266Client-";
    clientId += String(random(0xffff), HEX);
    
    if (mqttClient.connect(clientId.c_str())) 
    {
      Serial.println("connected");
      mqttClient.subscribe(suscribeTopic);
    } 
    else 
    {
      Serial.print("failed, rc=");
      Serial.print(mqttClient.state());
      Serial.println(" try again in 5 seconds");
      delay(5000);
    }
  }
}

void setup_wifi() 
{
  Serial.print("Connecting to ");
  Serial.print(ssid);
  WiFi.begin(ssid, password);
  while (WiFi.status() != WL_CONNECTED) 
  {
    delay(500);
    Serial.print(".");
  }
  Serial.print("\n¡WiFi connected!\nIP address:");
  Serial.println(WiFi.localIP());
}

void setup_mqttClient() 
{
  mqttClient.setServer(mqtt_server, 8883);
  mqttClient.setCallback(callback); 
  mqttClient.subscribe(suscribeTopic);
}

void gpio_setup()
{
  gpio_PWMA=5;    //  ESP8266=5 | ATMEGA2560=5
  gpio_AIN2=4;    //  ESP8266=4 | ATMEGA2560=4
  gpio_AIN1=0;    //  ESP8266=0 | ATMEGA2560=3
  gpio_STBY=2;    //  ESP8266=2 | ATMEGA2560=2
  pinMode(gpio_PWMA,OUTPUT); 
  pinMode(gpio_AIN2,OUTPUT); 
  pinMode(gpio_AIN1,OUTPUT); 
  pinMode(gpio_STBY,OUTPUT); 
  digitalWrite(gpio_PWMA, HIGH);  //PWM
}

void valve_close()
{
  digitalWrite(gpio_AIN1, LOW);   //IN1  
  digitalWrite(gpio_AIN2, HIGH);  //IN2
  digitalWrite(gpio_STBY, HIGH);  //STBY
  delay(50);
  digitalWrite(gpio_STBY, LOW);   //STBY                                      
}

void valve_open()
{
  digitalWrite(gpio_AIN1, HIGH);  //IN1
  digitalWrite(gpio_AIN2, LOW);   //IN2 
  digitalWrite(gpio_STBY, HIGH);  //STBY
  delay(50);
  digitalWrite(gpio_STBY, LOW);   //STBY                      
}

void setup() 
{
  Serial.begin(9600);
  setup_wifi();
  setup_time();
  setup_wifiClient();
  setup_mqttClient();
  gpio_setup();
  time1 = millis();   
}


void setup_time()
{
  configTime(timezone,dst,"pool.ntp.org","time.nist.gov");
  Serial.print("\nWaiting for internet time...");
  while(!time(nullptr))
  {
    Serial.print(".");
    delay(1000);  
  }
  Serial.println("Time response .... OK!");
}


void loop() 
{
  time2 = millis();
  
  if (!mqttClient.connected())  
    reconnect();
  
  if(time2 > (time1 + 20000)) // 20 secs elapsed?
  {  
    if(mqttClient.connected())
      mqttClient.loop();
    
    Serial.print("20 Secs!");
    if(cntLastPulses != 0)
    {   
      longArray = 0;
      for(int i = 0; data[i] != '\0' ; i++)
        longArray++;
              
      data[longArray] = lowByte(cntLastPulses);
      possibleLeak = leakTest();
      cntLastPulses = 0;
    }
    time1 = millis();
    if(mqttClient.connected())
      mqttClient.loop();
  }

  Serial.readBytes(dataFromSerial,10);
  if(!dataFromSerial[0])    
    Serial.print(".");
    
  else
  {
    if(mqttClient.connected())    
      mqttClient.loop();
    
    time_t now = time(nullptr);
    struct tm* p_tm = localtime(&now);
    String jsonString;
 
    Serial.println("Posting new message");
    
    jsonString.concat("{\"state\":{\"reported\":{\"pipe\":{\"totalm3water\":");
    jsonString.concat(dataFromSerial);
    jsonString.concat(", \"possibleLeak\":");
    jsonString.concat(possibleLeak);    
    jsonString.concat("},\"newMedition\":\"");
    jsonString.concat(String(p_tm->tm_hour));       // p_tm->tm_hour/tm_min : are integer
    jsonString.concat("-");
    jsonString.concat(String(p_tm->tm_min));
    jsonString.concat("\"}}}");  
    jsonString.toCharArray(jsonArray, 300);
    Serial.println(jsonString);
    mqttClient.publish(endPointPost,jsonArray);
    
    /* Clear arrays*/
    memset(dataFromSerial, '\0', sizeof(dataFromSerial));
    memset(hourArrayChar, '\0', sizeof(hourArrayChar));
    memset(minArrayChar, '\0', sizeof(minArrayChar));
    
    if(possibleLeak == '1')
      possibleLeak = '0';
  
    cntLastPulses++;
  } 
  
    if(mqttClient.connected())
      mqttClient.loop();
}

char leakTest()
{
  int average = 0, cnt = 0;
  Serial.println("Content in array [data]: ");
  for(int i = 0; data[i]!='\0' ; i++)
  {
    average += data[i];
    Serial.print('[');
    Serial.print(data[i]);
    Serial.println(']');
    cnt++;
  }
  Serial.print("Array [data] long:");
  Serial.println(cnt);
  average /= cnt;
  average += acceptanceRange;
  Serial.print("Average value:");
  Serial.println(average);
  Serial.print("Last number of pulses:");
  Serial.println(cntLastPulses);
  
  return ((cntLastPulses > average)?'1':'0');
}



/*        Json Format

{
    "state": 
    {
            "pipe" : 
            {
              "totalm3water": x,
              "possibleLeak": x,    
              "closePipe":x         
            },
            "newMedition":"xx-xx"
    }
}


*/